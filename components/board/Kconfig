## components/board/Kconfig
```kconfig
menu "Board"

    config MOTOR_FRONT_LEFT_IA_GPIO
        int "Front-left IA GPIO"
        range 0 33

    config MOTOR_FRONT_LEFT_IB_GPIO
        int "Front-left IB GPIO"
        range 0 33

    config MOTOR_FRONT_LEFT_INVERTED
        bool "Invert front-left motor direction"
        default n

    config MOTOR_FRONT_RIGHT_IA_GPIO
        int "Front-right IA GPIO"
        range 0 33

    config MOTOR_FRONT_RIGHT_IB_GPIO
        int "Front-right IB GPIO"
        range 0 33

    config MOTOR_FRONT_RIGHT_INVERTED
        bool "Invert front-right motor direction"
        default y

    config MOTOR_REAR_LEFT_IA_GPIO
        int "Rear-left IA GPIO"
        range 0 33

    config MOTOR_REAR_LEFT_IB_GPIO
        int "Rear-left IB GPIO"
        range 0 33

    config MOTOR_REAR_LEFT_INVERTED
        bool "Invert rear-left motor direction"
        default n

    config MOTOR_REAR_RIGHT_IA_GPIO
        int "Rear-right IA GPIO"
        range 0 33

    config MOTOR_REAR_RIGHT_IB_GPIO
        int "Rear-right IB GPIO"
        range 0 33

    config MOTOR_REAR_RIGHT_INVERTED
        bool "Invert rear-right motor direction"
        default y

    config ENCODER_LEFT_A_GPIO
        int "Left encoder A GPIO"
        range 0 39

    config ENCODER_LEFT_B_GPIO
        int "Left encoder B GPIO"
        range 0 39

    config ENCODER_LEFT_INVERTED
        bool "Invert left encoder direction"
        default n

    config ENCODER_RIGHT_A_GPIO
        int "Right encoder A GPIO"
        range 0 39

    config ENCODER_RIGHT_B_GPIO
        int "Right encoder B GPIO"
        range 0 39

    config ENCODER_RIGHT_INVERTED
        bool "Invert right encoder direction"
        default y

    config ENCODER_CPR
        int "Encoder counts per wheel revolution after quadrature"
        range 0 1000000
        default 0
        help
            Four-times quadrature counts for one wheel revolution, including
            gearbox ratio. Zero keeps closed-loop driving disabled.

    config ENCODER_GLITCH_FILTER_NS
        int "Encoder glitch filter (ns)"
        range 0 100000
        default 1000

    config MPU6050_SDA_GPIO
        int "MPU6050 SDA GPIO"
        range 0 39

    config MPU6050_SCL_GPIO
        int "MPU6050 SCL GPIO"
        range 0 39

    config MPU6050_I2C_ADDRESS
        hex "MPU6050 I2C address"
        range 0x68 0x69
        default 0x68

    config MPU6050_CALIBRATION_RATE_HZ
        int "MPU6050 stationary calibration rate (Hz)"
        range 10 1000
        default 100
        help
            Sampling interval used while calculating the startup bias. The
            Registry driver currently leaves the sensor output-data rate at
            its hardware configuration.

    config MPU6050_CALIBRATION_SAMPLES
        int "Stationary calibration samples"
        range 0 2000
        default 200

    config MOTOR_PWM_FREQUENCY_HZ
        int "Motor PWM frequency (Hz)"
        range 1000 40000
        default 20000
        help
            Keep 20000 Hz for normal operation. Set this to 1000 Hz temporarily
            when diagnosing motor startup or PWM waveform issues.

endmenu
```

## components/drive/Kconfig
```kconfig
menu "Drive control"

    config DRIVE_WHEEL_RADIUS_MM
        int "Wheel radius (mm)"
        range 0 1000
        default 0

    config DRIVE_TRACK_WIDTH_MM
        int "Left-right wheel track width (mm)"
        range 0 5000
        default 0

    config DRIVE_MAX_WHEEL_RPM
        int "Maximum wheel speed (RPM)"
        range 0 10000
        default 0

    config DRIVE_PID_KP_MILLI
        int "PID Kp x 1000"
        range 0 1000000
        default 0

    config DRIVE_PID_KI_MILLI
        int "PID Ki x 1000"
        range 0 1000000
        default 0

    config DRIVE_PID_KD_MILLI
        int "PID Kd x 1000"
        range 0 1000000
        default 0

    config DRIVE_CONTROL_PERIOD_MS
        int "Control period (ms)"
        range 5 20
        default 20
        help
            The upper bound guarantees that an emergency-stop request is
            consumed by the drive task within 20 ms.

    config DRIVE_COMMAND_TIMEOUT_MS
        int "Command timeout (ms)"
        range 100 5000
        default 500

    config DRIVE_STALL_TIMEOUT_MS
        int "Encoder stall timeout (ms)"
        range 100 5000
        default 500

endmenu
```

## components/imu/Kconfig
```kconfig
menu "Vehicle IMU"

    config IMU_I2C_TIMEOUT_MS
        int "MPU6050 I2C transaction timeout (ms)"
        range 1 1000
        default 20

    config IMU_SAMPLE_RATE_HZ
        int "IMU acquisition rate (Hz)"
        range 1 200
        default 50

    config IMU_RECOVERY_PERIOD_MS
        int "IMU recovery retry period (ms)"
        range 100 10000
        default 1000

endmenu
```

## components/imu/test_apps/unit/sdkconfig.defaults
```kconfig
CONFIG_ESP_MAIN_TASK_STACK_SIZE=4096
CONFIG_IMU_I2C_TIMEOUT_MS=20
CONFIG_IMU_SAMPLE_RATE_HZ=50
CONFIG_IMU_RECOVERY_PERIOD_MS=1000
```

## components/motor/Kconfig
```kconfig
menu "Motor control"

    config MOTOR_START_BOOST_SPEED
        int "Startup boost command"
        range 0 1000
        default 800
        help
            Command magnitude applied briefly when a stopped motor receives a
            lower non-zero command, or when it reverses direction. Set to 0 to
            disable startup boost.

    config MOTOR_START_BOOST_DURATION_MS
        int "Startup boost duration (ms)"
        range 1 1000
        default 100
        depends on MOTOR_START_BOOST_SPEED > 0
        help
            Time to hold the startup boost before returning to the requested
            command.

endmenu
```

## components/motor/test_apps/hardware/main/Kconfig.projbuild
```kconfig
menu "Motor hardware test pins"

    config MOTOR_FRONT_LEFT_IA_GPIO
        int "Front-left IA GPIO"
        range 0 33
        default 25

    config MOTOR_FRONT_LEFT_IB_GPIO
        int "Front-left IB GPIO"
        range 0 33
        default 26

    config MOTOR_FRONT_LEFT_INVERTED
        bool "Invert front-left motor direction"
        default n

    config MOTOR_FRONT_RIGHT_IA_GPIO
        int "Front-right IA GPIO"
        range 0 33
        default 27

    config MOTOR_FRONT_RIGHT_IB_GPIO
        int "Front-right IB GPIO"
        range 0 33
        default 14

    config MOTOR_FRONT_RIGHT_INVERTED
        bool "Invert front-right motor direction"
        default y

    config MOTOR_REAR_LEFT_IA_GPIO
        int "Rear-left IA GPIO"
        range 0 33
        default 19

    config MOTOR_REAR_LEFT_IB_GPIO
        int "Rear-left IB GPIO"
        range 0 33
        default 18

    config MOTOR_REAR_LEFT_INVERTED
        bool "Invert rear-left motor direction"
        default n

    config MOTOR_REAR_RIGHT_IA_GPIO
        int "Rear-right IA GPIO"
        range 0 33
        default 17

    config MOTOR_REAR_RIGHT_IB_GPIO
        int "Rear-right IB GPIO"
        range 0 33
        default 16

    config MOTOR_REAR_RIGHT_INVERTED
        bool "Invert rear-right motor direction"
        default y

    config MOTOR_PWM_FREQUENCY_HZ
        int "Motor PWM frequency (Hz)"
        range 1000 40000
        default 20000

endmenu
```

## components/motor/test_apps/hardware/sdkconfig.defaults
```kconfig
CONFIG_MOTOR_FRONT_LEFT_IA_GPIO=25
CONFIG_MOTOR_FRONT_LEFT_IB_GPIO=26
CONFIG_MOTOR_FRONT_RIGHT_IA_GPIO=27
CONFIG_MOTOR_FRONT_RIGHT_IB_GPIO=14
CONFIG_MOTOR_FRONT_RIGHT_INVERTED=y
CONFIG_MOTOR_REAR_LEFT_IA_GPIO=19
CONFIG_MOTOR_REAR_LEFT_IB_GPIO=18
CONFIG_MOTOR_REAR_RIGHT_IA_GPIO=17
CONFIG_MOTOR_REAR_RIGHT_IB_GPIO=16
CONFIG_MOTOR_REAR_RIGHT_INVERTED=y
CONFIG_MOTOR_PWM_FREQUENCY_HZ=20000
CONFIG_MOTOR_START_BOOST_SPEED=0

CONFIG_ESP_TASK_WDT_INIT=n
```

## components/ros_bridge/Kconfig
```kconfig
menu "Vehicle micro-ROS"

    config ROS_UART_BAUD
        int "UART0 transport baud rate"
        range 115200 2000000
        default 921600

    config ROS_IMU_PUBLISH_RATE_HZ
        int "IMU publish rate (Hz)"
        range 1 200
        default 50

    config ROS_DRIVE_PUBLISH_RATE_HZ
        int "Odometry and joint state publish rate (Hz)"
        range 1 100
        default 30

    config ROS_DIAGNOSTIC_PUBLISH_RATE_HZ
        int "Diagnostics publish rate (Hz)"
        range 1 20
        default 5

    config ROS_AGENT_PING_PERIOD_MS
        int "Connected Agent ping period (ms)"
        range 100 5000
        default 500

    config ROS_TIME_SYNC_RETRY_MS
        int "ROS epoch synchronization retry period (ms)"
        range 100 10000
        default 1000

    config ROS_PUBLISH_FAILURE_LIMIT
        int "Consecutive publisher failures before reconnect"
        range 1 100
        default 10

    config ROS_IMU_STALE_TIMEOUT_MS
        int "Maximum IMU snapshot age (ms)"
        range 20 10000
        default 100

    config ROS_DRIVE_STALE_TIMEOUT_MS
        int "Maximum drive snapshot age (ms)"
        range 20 10000
        default 100

    config ROS_IMU_ANGULAR_VARIANCE_MICRO
        int "IMU angular velocity variance (micro-units)"
        range 1 1000000
        default 1000

    config ROS_IMU_ACCEL_VARIANCE_MICRO
        int "IMU linear acceleration variance (micro-units)"
        range 1 10000000
        default 100000

    config ROS_ODOM_LINEAR_VARIANCE_MICRO
        int "Wheel odometry linear variance (micro-units)"
        range 1 10000000
        default 10000

    config ROS_ODOM_ANGULAR_VARIANCE_MICRO
        int "Wheel odometry yaw variance (micro-units)"
        range 1 10000000
        default 20000

endmenu
```

## components/ros_bridge/test_apps/unit/sdkconfig.defaults
```kconfig
CONFIG_IDF_TARGET="esp32"
CONFIG_ESP_CONSOLE_UART_DEFAULT=y
CONFIG_MICRO_ROS_ESP_XRCE_DDS_MIDDLEWARE=y
CONFIG_MICRO_ROS_ESP_UART_TRANSPORT=y
```

## sdkconfig.defaults
```kconfig
# Project configuration defaults

# UART0 is reserved for the micro-ROS XRCE-DDS serial transport.
CONFIG_ESP_CONSOLE_NONE=y
CONFIG_ESP_CONSOLE_SECONDARY_NONE=y
CONFIG_MICRO_ROS_ESP_XRCE_DDS_MIDDLEWARE=y
CONFIG_MICRO_ROS_ESP_UART_TRANSPORT=y
CONFIG_MICROROS_UART_TXD=-1
CONFIG_MICROROS_UART_RXD=-1
CONFIG_MICROROS_UART_RTS=-1
CONFIG_MICROROS_UART_CTS=-1
CONFIG_ROS_UART_BAUD=921600
CONFIG_ROS_IMU_PUBLISH_RATE_HZ=50
CONFIG_ROS_DRIVE_PUBLISH_RATE_HZ=30
CONFIG_ROS_DIAGNOSTIC_PUBLISH_RATE_HZ=5
CONFIG_ROS_AGENT_PING_PERIOD_MS=500
CONFIG_ROS_TIME_SYNC_RETRY_MS=1000
CONFIG_ROS_PUBLISH_FAILURE_LIMIT=10
CONFIG_ROS_IMU_STALE_TIMEOUT_MS=100
CONFIG_ROS_DRIVE_STALE_TIMEOUT_MS=100
CONFIG_ROS_IMU_ANGULAR_VARIANCE_MICRO=1000
CONFIG_ROS_IMU_ACCEL_VARIANCE_MICRO=100000
CONFIG_ROS_ODOM_LINEAR_VARIANCE_MICRO=10000
CONFIG_ROS_ODOM_ANGULAR_VARIANCE_MICRO=20000

# Motor control
CONFIG_MOTOR_FRONT_LEFT_IA_GPIO=25
CONFIG_MOTOR_FRONT_LEFT_IB_GPIO=26
CONFIG_MOTOR_FRONT_RIGHT_IA_GPIO=27
CONFIG_MOTOR_FRONT_RIGHT_IB_GPIO=14
CONFIG_MOTOR_FRONT_RIGHT_INVERTED=y
CONFIG_MOTOR_REAR_LEFT_IA_GPIO=19
CONFIG_MOTOR_REAR_LEFT_IB_GPIO=18
CONFIG_MOTOR_REAR_RIGHT_IA_GPIO=17
CONFIG_MOTOR_REAR_RIGHT_IB_GPIO=16
CONFIG_MOTOR_REAR_RIGHT_INVERTED=y
CONFIG_MOTOR_PWM_FREQUENCY_HZ=20000
CONFIG_MOTOR_START_BOOST_SPEED=800
CONFIG_MOTOR_START_BOOST_DURATION_MS=100

# Encoder inputs
CONFIG_ENCODER_LEFT_A_GPIO=32
CONFIG_ENCODER_LEFT_B_GPIO=33
CONFIG_ENCODER_RIGHT_A_GPIO=34
CONFIG_ENCODER_RIGHT_B_GPIO=35
CONFIG_ENCODER_RIGHT_INVERTED=y
CONFIG_ENCODER_CPR=0
CONFIG_ENCODER_GLITCH_FILTER_NS=1000

# MPU6050 I2C and stationary calibration
CONFIG_MPU6050_SDA_GPIO=21
CONFIG_MPU6050_SCL_GPIO=22
CONFIG_MPU6050_I2C_ADDRESS=0x68
CONFIG_MPU6050_CALIBRATION_RATE_HZ=100
CONFIG_MPU6050_CALIBRATION_SAMPLES=200
CONFIG_IMU_I2C_TIMEOUT_MS=20
CONFIG_IMU_SAMPLE_RATE_HZ=50
CONFIG_IMU_RECOVERY_PERIOD_MS=1000

# Closed-loop driving remains disabled until these measured values and gains
# are configured for the physical vehicle.
CONFIG_DRIVE_WHEEL_RADIUS_MM=0
CONFIG_DRIVE_TRACK_WIDTH_MM=0
CONFIG_DRIVE_MAX_WHEEL_RPM=0
CONFIG_DRIVE_PID_KP_MILLI=0
CONFIG_DRIVE_PID_KI_MILLI=0
CONFIG_DRIVE_PID_KD_MILLI=0
CONFIG_DRIVE_CONTROL_PERIOD_MS=20
CONFIG_DRIVE_COMMAND_TIMEOUT_MS=500
CONFIG_DRIVE_STALL_TIMEOUT_MS=500
```
